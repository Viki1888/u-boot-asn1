## board/thead/ice-c910/Kconfig
```kconfig
if TARGET_ICE_C910

config SYS_CPU
	default "generic"

config SYS_VENDOR
	default "thead"

config SYS_BOARD
	default "ice-c910"

config SYS_CONFIG_NAME
	default "ice-c910"

config SYS_TEXT_BASE
	default 0x40000000 if !RISCV_SMODE
	default 0x40200000 if RISCV_SMODE

config BOARD_SPECIFIC_OPTIONS # dummy
	def_bool y
	select GENERIC_RISCV
	imply CMD_FAT
	imply CMD_NET
	imply CMD_PING
	imply MII
	imply NET_RANDOM_ETHADDR
	imply PHY_LIB
	imply PHY_MSCC
	imply SPI
	imply MMC
	imply MMC_SPI
	imply MMC_BROKEN_CD
	imply CMD_MMC
	imply SMP

endif
```

## board/thead/light-c910/Kconfig
```kconfig
#
# Copyright (C) 2017-2020 Alibaba Group Holding Limited
#
# SPDX-License-Identifier: GPL-2.0+
#

if TARGET_LIGHT_C910

config SYS_CPU
    default "c9xx"

config SYS_VENDOR
    default "thead"

config SYS_BOARD
    default "light-c910"

config SYS_CONFIG_NAME
    default "light-c910"

config LIGHT_SEC_BOOT
    bool "light security boot"
    default n

config TARGET_LIGHT_FPGA_FM_C910
    bool "light fullmask FPGA board"
    default n

config SYS_TEXT_BASE
    default 0xc0000000 if RISCV_MMODE
    default 0x00200000 if RISCV_SMODE

config SPL_TEXT_BASE
    hex
    default 0xffe0000800 if LIGHT_SEC_BOOT
    default 0xffe0000000 if !LIGHT_SEC_BOOT

config SPL_MAX_SIZE
    hex
    default 0x2f000

config BOARD_SPECIFIC_OPTIONS
    def_bool y
    select RISCV_THEAD
    imply CMD_NET
    imply CMD_PING
    imply CMD_MEMINFO
    imply MII
    imply NET_RANDOM_ETHADDR
    imply PHY_LIB
    imply PHY_MSCC
    imply MMC
    imply MMC_SPI
    imply MMC_BROKEN_CD
    imply CMD_MMC

endif
```

## configs/ice_c910_defconfig
```kconfig
CONFIG_RISCV=y
CONFIG_ENV_SIZE=0x20000
CONFIG_NR_DRAM_BANKS=1
CONFIG_TARGET_ICE_C910=y
CONFIG_SYS_PROMPT="C910 # "
CONFIG_ARCH_RV64I=y
CONFIG_RISCV_SMODE=y
CONFIG_DISTRO_DEFAULTS=y
CONFIG_FIT=y
CONFIG_DEFAULT_DEVICE_TREE="ice-c910"
CONFIG_DISPLAY_CPUINFO=y
CONFIG_DISPLAY_BOARDINFO=y
CONFIG_OF_PRIOR_STAGE=y
CONFIG_SYS_RELOC_GD_ENV_ADDR=y
CONFIG_SYS_NS16550=y
# CONFIG_EFI_LOADER is not set
# CONFIG_PARTITIONS is not set
# CONFIG_PPL is not set
CONFIG_SPL=y
# CONFIG_SPL_FRAMEWORK is not set
# CONFIG_SPL_OF_CONTROL is not set
# CONFIG_SPL_SERIAL_SUPPORT is not set
CONFIG_SPL_LOAD_FIT=y
```

## configs/ice_evb_c910_defconfig
```kconfig
CONFIG_RISCV=y
# CONFIG_SPL_SERIAL_SUPPORT is not set
CONFIG_ENV_SIZE=0x20000
CONFIG_ENV_OFFSET=0x1e0000
CONFIG_NR_DRAM_BANKS=1
CONFIG_SPL=y
CONFIG_TARGET_ICE_C910=y
CONFIG_IS_ASICF=y
CONFIG_ARCH_RV64I=y
CONFIG_RISCV_SMODE=y
CONFIG_DISTRO_DEFAULTS=y
CONFIG_FIT=y
CONFIG_DISPLAY_CPUINFO=y
CONFIG_DISPLAY_BOARDINFO=y
CONFIG_PPL=y
# CONFIG_SPL_FRAMEWORK is not set
CONFIG_SYS_PROMPT="C910 # "
CONFIG_CMD_ERASEENV=y
CONFIG_CMD_GPT=y
# CONFIG_SPL_OF_CONTROL is not set
CONFIG_OF_PRIOR_STAGE=y
CONFIG_DEFAULT_DEVICE_TREE="ice-c910"
CONFIG_ENV_IS_IN_MMC=y
CONFIG_SYS_RELOC_GD_ENV_ADDR=y
# CONFIG_SPL_BLK is not set
CONFIG_UDP_FUNCTION_FASTBOOT=y
CONFIG_FASTBOOT_BUF_ADDR=0x02000000
CONFIG_FASTBOOT_FLASH=y
CONFIG_FASTBOOT_FLASH_MMC_DEV=0
CONFIG_FASTBOOT_CMD_OEM_FORMAT=y
CONFIG_MMC_DW=y
CONFIG_MMC_DW_SNPS=y
CONFIG_ETH_DESIGNWARE=y
CONFIG_SYS_NS16550=y
# CONFIG_SPL_TIMER is not set
# CONFIG_EFI_LOADER is not set
```

## drivers/video/light/Kconfig
```kconfig
#
# Light Video configuration
#

config VIDEO_VS_DPU
	bool "Verisilicon DPU(DC8200) video support"
	depends on DM_VIDEO && TARGET_LIGHT_C910
	help
	  Support for Verisilicon DPU controller on Light platform

config VIDEO_DW_DSI_LIGHT
	bool "Synopsys Designware MIPI DSI support on Light"
	depends on DM_VIDEO && TARGET_LIGHT_C910
	select VIDEO_DW_DSI_HOST
	help
	  support for Synopsys Designware MIPI DSI on Thead
	  Light platform.
```
